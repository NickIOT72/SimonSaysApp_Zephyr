## CMakeLists.txt
```
# SPDX-License-Identifier: Apache-2.0

cmake_minimum_required(VERSION 3.20.0)
find_package(Zephyr REQUIRED HINTS $ENV{ZEPHYR_BASE})
project(SimonSays)

target_sources(app PRIVATE
    src/main.c
    src/modules/led/led.c
    src/modules/button/button.c
    src/modules/shell/shell.c)
# Add include paths
target_include_directories(app PRIVATE
    # Add user defined include pathss
    src
    src/modules/led
    src/modules/button
    src/modules/shell
)
```

## prj.conf
```kconfig
CONFIG_GPIO=y

# Shell
CONFIG_SHELL=y
CONFIG_SHELL_BACKEND_SERIAL_CHECK_DTR=y
CONFIG_SHELL_PROMPT_UART="shell:~$ "
```

## src/main.c
```c
/*
 * Copyright (c) 2016 Intel Corporation
 *
 * SPDX-License-Identifier: Apache-2.0
 */

#include "main.h"

#define SLEEP_TIME_MS   1000

void button_pressed(const struct device *dev, struct gpio_callback *cb, uint32_t pins)
{
  uint32_t bit_to_pin = 0;
	for (int i = 0; i < 32; i++) {
		if ((pins >> i) == 1) {
			bit_to_pin = i;
			break;
		}
	}
	if( bit_to_pin == 0 ) return;

	printk("pin %d interrupted at %llu\n", bit_to_pin, k_uptime_get());
}

int button_setUpInterruption( const struct gpio_dt_spec *btn , const gpio_flags_t pin_flag, struct gpio_callback *btn_cb_data  )
{
	int ret = 0;

	ret = gpio_pin_interrupt_configure_dt(btn, pin_flag);
	if (ret < 0) {
		return 0;
	}

	gpio_init_callback(btn_cb_data, button_pressed  , BIT(btn->pin));

	gpio_add_callback(btn->port, btn_cb_data);
	
	return ret;
}

int main(void)
{
	int ret;
	int leds_total = sizeof(leds)/sizeof(leds[0]);

	for(int i = 0; i <  leds_total; i++)
	{
		ret = led_init(&leds[i], pins_flag[i]);
		if (ret < 0) {
	  	return 0;
	  }
		printk("Set up LED at %s pin %d\r\n", leds[i].port->name, leds[i].pin);

		ret = button_init(&buttons[i], buttons_flag[i]);
		if (ret < 0) {
	  	return 0;
	  }

		ret = button_setUpInterruption( &buttons[i] , buttons_interruption_flag[i],  &button_cb_data[i] );
		if (ret < 0) {
	  	return 0;
	  }
		printk("Set up button at %s pin %d\r\n", buttons[i].port->name, buttons[i].pin);
	}

	while (1) {
		for( int i = 0; i < leds_total; i++ ) {	
			ret = led_ON(&leds[i]);
      if (ret < 0) {
        return 0;
      }
      k_msleep(SLEEP_TIME_MS);
			ret = led_OFF(&leds[i]);
      if (ret < 0) {
        return 0;
      }
      k_msleep(SLEEP_TIME_MS);
		}
	}
	return 0;
}
```

## src/main.h
```c
#include <zephyr/kernel.h>
#include "modules/led/led.h"
#include "modules/button/button.h"
#include "modules/shell/shell.h"

/* The devicetree node identifier for the "led0" alias. */
#define LED0_NODE DT_ALIAS(led0)
#define LED1_NODE DT_ALIAS(led1)
#define LED2_NODE DT_ALIAS(led2)
#define LED3_NODE DT_ALIAS(led3)

/*
 * A build error on this line means your board is unsupported.
 * See the sample documentation for information on how to fix this.
 */

static const struct gpio_dt_spec leds[4] =
{
	GPIO_DT_SPEC_GET(LED0_NODE, gpios),
	GPIO_DT_SPEC_GET(LED1_NODE, gpios),
  GPIO_DT_SPEC_GET(LED2_NODE, gpios),
	GPIO_DT_SPEC_GET(LED3_NODE, gpios),
};

static const gpio_flags_t pins_flag[4] = {
	GPIO_OUTPUT_INACTIVE,
	GPIO_OUTPUT_INACTIVE,
  GPIO_OUTPUT_INACTIVE,
  GPIO_OUTPUT_INACTIVE
};


/*
 * Get button configuration from the devicetree sw0 alias. This is mandatory.
 */
#define SW0_NODE DT_ALIAS(sw0)
#if !DT_NODE_HAS_STATUS(SW0_NODE, okay)
#error "Unsupported board: sw0 devicetree alias is not defined"
#endif

#define SW1_NODE DT_ALIAS(sw1)
#if !DT_NODE_HAS_STATUS(SW1_NODE, okay)
#error "Unsupported board: sw1 devicetree alias is not defined"
#endif

#define SW2_NODE DT_ALIAS(sw2)
#if !DT_NODE_HAS_STATUS(SW2_NODE, okay)
#error "Unsupported board: sw2 devicetree alias is not defined"
#endif

#define SW3_NODE DT_ALIAS(sw3)
#if !DT_NODE_HAS_STATUS(SW3_NODE, okay)
#error "Unsupported board: sw3 devicetree alias is not defined"
#endif

static const struct gpio_dt_spec buttons[4] = {
	GPIO_DT_SPEC_GET_OR(SW0_NODE, gpios, {0}),
	GPIO_DT_SPEC_GET_OR(SW1_NODE, gpios, {0}),
	GPIO_DT_SPEC_GET_OR(SW2_NODE, gpios, {0}),
	GPIO_DT_SPEC_GET_OR(SW3_NODE, gpios, {0})};

static const gpio_flags_t buttons_flag[4] = {
	GPIO_INPUT,
	GPIO_INPUT,
  GPIO_INPUT,
  GPIO_INPUT
};

static const gpio_flags_t buttons_interruption_flag[4] = {
	GPIO_INT_EDGE_TO_ACTIVE,
	GPIO_INT_EDGE_TO_ACTIVE,
  GPIO_INT_EDGE_TO_ACTIVE,
  GPIO_INT_EDGE_TO_ACTIVE
};


static struct gpio_callback button_cb_data[4];
```
